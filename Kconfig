## Kconfig
```kconfig
orsource "$IDF_PATH/examples/common_components/env_caps/$IDF_TARGET/Kconfig.env_caps"

menu "MCM - PPM Bootloader Configuration"

    config PPM_BOOTLOADER_RX
        int "RXD pin number"
        range ENV_GPIO_RANGE_MIN ENV_GPIO_IN_RANGE_MAX
        default 6
        help
            GPIO number for PPM Bootloader RX pin.

    config PPM_BOOTLOADER_TX
        int "TXD pin number"
        range ENV_GPIO_RANGE_MIN ENV_GPIO_OUT_RANGE_MAX
        default 7
        help
            GPIO number for PPM Bootloader TX pin.

    config PPM_BOOTLOADER_TX_INVERT
        bool "invert TX signal"
        default y
        help
            Whether or not to invert the TX signal.

endmenu
```
